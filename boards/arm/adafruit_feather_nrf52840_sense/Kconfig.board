## boards/arm/adafruit_feather_nrf52840_sense/Kconfig.board
```kconfig
# Adafruit Feather nRF52840 Express board configuration

# Copyright (c) 2020 Tobias Svehagen, 2021 Thomas Popp
# SPDX-License-Identifier: Apache-2.0

config BOARD_ADAFRUIT_FEATHER_NRF52840_SENSE
	bool "Adafruit Feather nRF52840 Sense"
	depends on SOC_NRF52840_QIAA
```

## boards/arm/adafruit_feather_nrf52840_sense/Kconfig.defconfig
```kconfig
# Adafruit Feather nRF52840 Express board configuration

# Copyright (c) 2020 Tobias Svehagen
# SPDX-License-Identifier: Apache-2.0

if BOARD_ADAFRUIT_FEATHER_NRF52840_SENSE

config BOARD
	default "adafruit feather nrf52840 sense"

if USB

config USB_NRFX
	default y

config USB_DEVICE_STACK
	default y

endif # USB

config BT_CTLR
	default BT

endif # BOARD_ADAFRUIT_FEATHER_NRF52840_SENSE
```
