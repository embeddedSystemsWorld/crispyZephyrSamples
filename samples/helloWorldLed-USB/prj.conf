## prj.conf
```kconfig
# config peripherals
CONFIG_GPIO=y
CONFIG_SERIAL=y
CONFIG_SPI=n
CONFIG_I2C=n


# configs for USB console
CONFIG_USB=y
CONFIG_USB_DEVICE_STACK=y
CONFIG_USB_DEVICE_PRODUCT="#arve USB console"
CONFIG_USB_UART_CONSOLE=y
CONFIG_USB_CDC_ACM_LOG_LEVEL_ERR=y

CONFIG_UART_INTERRUPT_DRIVEN=y
CONFIG_UART_LINE_CTRL=y
CONFIG_UART_CONSOLE_ON_DEV_NAME="CDC_ACM_0"

# config logging
CONFIG_LOG=y
CONFIG_PRINTK=y
CONFIG_LOG_PRINTK=y
CONFIG_LOG_BUFFER_SIZE=2048
```

## src/main.c
```c
/*
 * Copyright (c) 2020 Thomas Popp
 *
 * SPDX-License-Identifier: Apache-2.0
 */

#include <zephyr.h>
#include <device.h>
#include <devicetree.h>
#include <drivers/gpio.h>

#include "usbconsole.h"

// ---- logging includes/defines -----------------------------------------------
#include <logging/log.h>
#include <logging/log_ctrl.h>
#define CONFIG_APP_LOG_LEVEL           LOG_LEVEL_DBG
LOG_MODULE_REGISTER(app, CONFIG_APP_LOG_LEVEL);


// ---- defines LED0 for the LED pin -------------------------------------------
// the devicetree node identifier for the "led0" alias.
#define LED0_NODE DT_ALIAS(led0)

#if DT_NODE_HAS_STATUS(LED0_NODE, okay)
#define LED0	DT_GPIO_LABEL(LED0_NODE, gpios)
#define PIN	DT_GPIO_PIN(LED0_NODE, gpios)
#define FLAGS	DT_GPIO_FLAGS(LED0_NODE, gpios)
#else
// a build error here means your board isn't set up to blink an LED.
#error "Unsupported board: led0 devicetree alias is not defined"
#define LED0	""
#define PIN	0
#define FLAGS	0
#endif

// LED cycle defs
#define LED0_CYCLE_TIME 1000
#define LED0_ON_TIME     100
#define LED0_OFF_TIME   LED0_CYCLE_TIME - LED0_ON_TIME

// -----------------------------------------------------------------------------
void main (void) {
    const struct device *dev;
    int rc;

    rc = usbconole_init();
    
    // init the LED
    dev = device_get_binding(LED0);
    if (dev == NULL) {
        return;
    }

    rc = gpio_pin_configure(dev, PIN, GPIO_OUTPUT_ACTIVE | FLAGS);
    if (rc < 0) {
        return;
    }  
    
    // run the loop for ever    
    while (true) {
        LOG_INF("Hello World from %s board!", CONFIG_BOARD);
        gpio_pin_set(dev, PIN, (int)true);
        k_msleep(LED0_ON_TIME);        
        gpio_pin_set(dev, PIN, (int)false);
        k_msleep(LED0_OFF_TIME);        
    }

}
```

## src/usbconsole.c
```c
// ---- zephyr includes --------------------------------------------------------
#include <zephyr.h>
// #include <device.h>
// #include <devicetree.h>
// #include <drivers/gpio.h>

#include <usb/usb_device.h>
#include <drivers/uart.h>

// #include "error.h"

// ---- module include- --------------------------------------------------------
#include "usbconsole.h"


// ---- logging includes/defines -----------------------------------------------
#include <logging/log.h>
#define CONFIG_STATUS_LOG_LEVEL   LOG_LEVEL_INF
LOG_MODULE_REGISTER(usbconsole, CONFIG_STATUS_LOG_LEVEL);

#define NO_ERR 0

#define GEN_ERR -1


int usbconole_init(void) {
    const struct device *dev = device_get_binding(
            CONFIG_UART_CONSOLE_ON_DEV_NAME);
    uint32_t dtr = 0U;
    uint32_t baudrate;
    int ret;    
    
    LOG_INF("init");  
    
    if (!dev) {
        LOG_ERR("CDC ACM device not found");
        return (GEN_ERR);
    }

    ret = usb_enable(NULL);
    if (ret != 0) {
        LOG_ERR("Failed to enable USB");
        return (GEN_ERR);
    }

// 	ring_buf_init(&ringbuf, sizeof(ring_buffer), ring_buffer);

    LOG_INF("Wait for DTR");

    uint32_t timeout = 0;
    while (true) {
        uart_line_ctrl_get(dev, UART_LINE_CTRL_DTR, &dtr);
        if (dtr) {
            break;
        } else {
            /* Give CPU resources to low priority threads. */
            k_sleep(K_MSEC(100));
            
            if (timeout > 10) {
                return (-ETIME);
            }
            else {
                timeout++;
            }
        }
    }

    LOG_INF("DTR set");

    /* They are optional, we use them to test the interrupt endpoint */
    ret = uart_line_ctrl_set(dev, UART_LINE_CTRL_DCD, 1);
    if (ret) {
        LOG_WRN("Failed to set DCD, ret code %d", ret);
    }

    ret = uart_line_ctrl_set(dev, UART_LINE_CTRL_DSR, 1);
    if (ret) {
        LOG_WRN("Failed to set DSR, ret code %d", ret);
    }

    /* Wait 1 sec for the host to do all settings */
    k_busy_wait(1000000);

    ret = uart_line_ctrl_get(dev, UART_LINE_CTRL_BAUD_RATE, &baudrate);
    if (ret) {
        LOG_WRN("Failed to get baudrate, ret code %d", ret);
    } else {
        LOG_INF("Baudrate detected: %d", baudrate);
    }
    return (NO_ERR);
}
```

## src/usbconsole.h
```c
extern int usbconole_init(void);
```
